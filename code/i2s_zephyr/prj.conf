## CMakeLists.txt
```
cmake_minimum_required(VERSION 3.13.1)
find_package(Zephyr)
project(my_zephyr_app)

set(CMSIS_DSP_INCLUDE_DIR "/home/mahesh/CMSIS/CMSIS_5-5.7.0/CMSIS/DSP/Include")
set(CMSIS_DSP_SRC_DIR "/home/mahesh/CMSIS/CMSIS_5-5.7.0/CMSIS/DSP/Source")

set(CMSIS_NN_INCLUDE_DIR "/home/mahesh/CMSIS/CMSIS_5-5.7.0/CMSIS/NN/Include")
set(CMSIS_NN_SRC_DIR "/home/mahesh/CMSIS/CMSIS_5-5.7.0/CMSIS/NN/Source")

target_include_directories(app PRIVATE ${CMSIS_DSP_INCLUDE_DIR})
target_include_directories(app PRIVATE ${CMSIS_NN_INCLUDE_DIR})

# Add your source file to the "app" target. This must come after
# find_package(Zephyr) which defines the target.
target_sources(app PRIVATE src/main.c)
target_sources(app PRIVATE src/loopback.c)
target_sources(app PRIVATE src/i2s_mic.c)
target_sources(app PRIVATE src/cmsis_dsp_test.c)
target_sources(app PRIVATE src/cmsis_nn_test.c)

target_sources(app PRIVATE ${CMSIS_DSP_SRC_DIR}/TransformFunctions/TransformFunctions.c)
#target_sources(app PRIVATE ${CMSIS_DSP_SRC_DIR}/CommonTables/arm_const_structs.c)
#target_sources(app PRIVATE ${CMSIS_DSP_SRC_DIR}/CommonTables/arm_common_tables.c)

target_sources(app PRIVATE ${CMSIS_NN_SRC_DIR}/SoftmaxFunctions/arm_softmax_q7.c)
target_sources(app PRIVATE ${CMSIS_NN_SRC_DIR}/ActivationFunctions/arm_nn_activations_q7.c)
target_sources(app PRIVATE ${CMSIS_NN_SRC_DIR}/ActivationFunctions/arm_relu_q7.c)
target_sources(app PRIVATE ${CMSIS_NN_SRC_DIR}/ConvolutionFunctions/arm_convolve_HWC_q7_fast.c)
target_sources(app PRIVATE ${CMSIS_NN_SRC_DIR}/ConvolutionFunctions/arm_convolve_HWC_q7_RGB.c)
target_sources(app PRIVATE ${CMSIS_NN_SRC_DIR}/ConvolutionFunctions/arm_convolve_HWC_q7_basic.c)
target_sources(app PRIVATE ${CMSIS_NN_SRC_DIR}/NNSupportFunctions/arm_q7_to_q15_no_shift.c)
target_sources(app PRIVATE ${CMSIS_NN_SRC_DIR}/FullyConnectedFunctions/arm_fully_connected_q7.c)
target_sources(app PRIVATE ${CMSIS_NN_SRC_DIR}/FullyConnectedFunctions/arm_fully_connected_q7_opt.c)
target_sources(app PRIVATE ${CMSIS_NN_SRC_DIR}/PoolingFunctions/arm_pool_q7_HWC.c)
target_sources(app PRIVATE ${CMSIS_NN_SRC_DIR}/NNSupportFunctions/arm_q7_to_q15_reordered_no_shift.c)
target_sources(app PRIVATE ${CMSIS_NN_SRC_DIR}/ConvolutionFunctions/arm_nn_mat_mult_kernel_q7_q15_reordered.c)
target_sources(app PRIVATE ${CMSIS_NN_SRC_DIR}/ConvolutionFunctions/arm_nn_mat_mult_kernel_q7_q15.c)
```

## prj.conf
```kconfig
# prj.conf
CONFIG_LOG=y

CONFIG_NRFX_I2S=y
#CONFIG_UART_NRFX=y

CONFIG_GPIO=y

#CONFIG_CMSIS_DSP=y
#CONFIG_CMSIS_DSP_TRANSFORM=y
CONFIG_NEWLIB_LIBC=y
CONFIG_FPU=y

# # Set CONFIG_NEWLIB_LIBC_FLOAT_PRINTF if  printf should be able to print float
CONFIG_NEWLIB_LIBC_FLOAT_PRINTF=y
```

## src/main.c
```c
// main.c
#include <zephyr.h>

#include <drivers/uart.h>

#include <nrfx_i2s.h>

#include <drivers/gpio.h>

#include <stdio.h>
#include <stdlib.h>

#include <logging/log.h>
LOG_MODULE_REGISTER(i2s_zephyr, LOG_LEVEL_INF);

#include "cmsis_nn_test.h"

// enable for I2S loopback test 
//#define LOOPBACK_TEST

#ifdef LOOPBACK_TEST
#include "loopback.h"
#endif

#include "cmsis_dsp_test.h"
#include "i2s_mic.h"

void main(void)
{
    LOG_INF("hello I2S...");
    printk("hello I2S...\n");

#ifdef LOOPBACK_TEST
    loopback_init();
#endif

    //i2s_mic_init();

    //i2s_mic_test();


    //struct device* dev = device_get_binding("GPIO_0");
    //gpio_pin_configure(dev, 26, GPIO_OUTPUT); 


    //struct device *dev = device_get_binding("UART_0");                                                                                                                                                                               
    //uart_poll_out(dev, 'A'); 

    //cmsis_dsp_test();

    cmsis_nn_test();

    // main loop 
    for(;;) {

#ifdef LOOPBACK_TEST
        //loopback_transfer();
        k_msleep(2000);
#endif 

    	//gpio_pin_toggle(dev, 26);

        k_msleep(200);
    }
}
```

## src/cmsis_dsp_test.c
```c
#include "cmsis_dsp_test.h"

#include <stdio.h>

#include "arm_math.h"
#include "arm_const_structs.h"

float32_t testInput[32] =
{
    0.0,
    1.9509032201612824,
    3.826834323650898,
    5.555702330196022,
    7.071067811865475,
    8.314696123025453,
    9.238795325112868,
    9.807852804032304,
    10.0,
    9.807852804032304,
    9.238795325112868,
    8.314696123025454,
    7.0710678118654755,
    5.555702330196022,
    3.826834323650899,
    1.9509032201612861,
    1.2246467991473533e-15,
    -1.9509032201612837,
    -3.8268343236508966,
    -5.55570233019602,
    -7.071067811865475,
    -8.314696123025453,
    -9.238795325112864,
    -9.807852804032303,
    -10.0,
    -9.807852804032304,
    -9.238795325112866,
    -8.314696123025454,
    -7.071067811865477,
    -5.555702330196022,
    -3.826834323650904,
    -1.9509032201612873
};
float32_t testOutput[32];

void cmsis_dsp_test()
{ 
    arm_rfft_fast_instance_f32 S; // RFFT instance
    arm_status status;
    status = arm_rfft_fast_init_f32(&S, 32);
    arm_rfft_fast_f32(&S, testInput, testOutput, 0);

    if ( status != ARM_MATH_SUCCESS)
    {
        while (1);
    }
    printf("N, Amplitude\r\n");
    for (int i = 0; i < sizeof(testInput)/sizeof(testInput[0]); i++)
    {
        printf("%d, %f\r\n", i, testInput[i]);
    }

    printf("N, Freq\r\n");
    for (int i = 0; i < sizeof(testOutput)/sizeof(testOutput[0]); i++)
    {
        printf("%d, %f\r\n", i, testOutput[i]);
    }
}
```

## src/cmsis_dsp_test.h
```c
// cmsis_dsp_test.h
#ifndef _CMSIS_DSP_TEST
#define _CMSIS_DSP_TEST

void cmsis_dsp_test();

#endif // _CMSIS_DSP_TEST
```

## src/cmsis_nn_test.c
```c
#include "cmsis_nn_test.h"

#include <stdio.h>

#include <arm_math.h>
#include <arm_nnfunctions.h>

#include "spectrogram.h"
#include "weights.h"


#define CONV1_IM_DIM 32
#define CONV1_IM_CH 1
#define CONV1_KER_DIM 3
#define CONV1_PADDING 0
#define CONV1_STRIDE 2
#define CONV1_OUT_CH 16
#define CONV1_OUT_DIM 15

#define POOL1_KER_DIM 2
#define POOL1_STRIDE 0
#define POOL1_PADDING 0
#define POOL1_OUT_DIM 7

#define IP1_DIM 784 // 7*7*16
#define IP1_OUT 4

static q7_t conv1_wt[CONV1_IM_CH * CONV1_KER_DIM * CONV1_KER_DIM * CONV1_OUT_CH] = CONV1_WT;
static q7_t conv1_bias[CONV1_OUT_CH] = CONV1_BIAS;

static q7_t ip1_wt[IP1_DIM * IP1_OUT] = IP1_WT;
static q7_t ip1_bias[IP1_OUT] = IP1_BIAS;

/* Here the image_data should be the raw uint8 type RGB image in [RGB, RGB, RGB ... RGB] format */
uint8_t   image_data[CONV1_IM_CH * CONV1_IM_DIM * CONV1_IM_DIM] = IMG_DATA;
q7_t      output_data[IP1_OUT];

// https://www.dlology.com/blog/how-to-run-deep-learning-model-on-microcontroller-with-cmsis-nn-part-2/
// To find out the required col_buffer size across all convolutional layers, this formula below is applied.
// 2*2*(conv # of filters)*(kernel width)*(kernel height)
// 2*2*16*3*3

//vector buffer: max(im2col buffer,average pool buffer, fully connected buffer)
q7_t      col_buffer[2 * 3 * 3 * 16 * 2];

q7_t      scratch_buffer[15*15*16 + 7*7*16];

void cmsis_nn_test()
{
    q7_t     *img_buffer1 = scratch_buffer;
    q7_t     *img_buffer2 = img_buffer1 + 15*15*16;

    arm_status status = ARM_MATH_SUCCESS;
    // convolution layer
    arm_convolve_HWC_q7_RGB(img_buffer1, CONV1_IM_DIM, CONV1_IM_CH, conv1_wt, CONV1_OUT_CH, CONV1_KER_DIM, CONV1_PADDING,
                            CONV1_STRIDE, conv1_bias, CONV1_BIAS_LSHIFT, CONV1_OUT_RSHIFT, img_buffer1, CONV1_OUT_DIM,
                            (q15_t *) col_buffer, NULL);

    /*
arm_status arm_convolve_HWC_q7_basic	(	
    const q7_t * 	Im_in,
const uint16_t 	dim_im_in,
const uint16_t 	ch_im_in,
const q7_t * 	wt,
const uint16_t 	ch_im_out,
const uint16_t 	dim_kernel,
const uint16_t 	padding,
const uint16_t 	stride,
const q7_t * 	bias,
const uint16_t 	bias_shift,
const uint16_t 	out_shift,
q7_t * 	Im_out,
const uint16_t 	dim_im_out,
q15_t * 	bufferA,
q7_t * 	bufferB 
)	*/
    status = arm_convolve_HWC_q7_basic(image_data, CONV1_IM_DIM, CONV1_IM_CH, conv1_wt, CONV1_OUT_CH, CONV1_KER_DIM, CONV1_PADDING,
                            CONV1_STRIDE, conv1_bias, CONV1_BIAS_LSHIFT, CONV1_OUT_RSHIFT, img_buffer1, CONV1_OUT_DIM,
                            (q15_t *) col_buffer, NULL);

    if (status != ARM_MATH_SUCCESS) {
        printf("conv2d failed with status = %d\n", status);
    }

    // relu 
    arm_relu_q7(img_buffer1, CONV1_OUT_DIM * CONV1_OUT_DIM * CONV1_OUT_CH);

    if (status != ARM_MATH_SUCCESS) {
        printf("relu failed with status = %d\n", status);
    }

    // maxpool
    arm_maxpool_q7_HWC(img_buffer1, CONV1_OUT_DIM, CONV1_OUT_CH, POOL1_KER_DIM,
                        POOL1_PADDING, POOL1_STRIDE, POOL1_OUT_DIM, NULL, img_buffer2);

    if (status != ARM_MATH_SUCCESS) {
        printf("maxpool failed with status = %d\n", status);
    }

    // dense layer 
    arm_fully_connected_q7_opt(img_buffer2, ip1_wt, IP1_DIM, IP1_OUT, IP1_BIAS_LSHIFT, IP1_OUT_RSHIFT, ip1_bias,
                                output_data, (q15_t *) img_buffer1);
    if (status != ARM_MATH_SUCCESS) {
        printf("dense failed with status = %d\n", status);
    }

    printf("dense:\n");
    for (int i = 0; i < 4; i++)
    {
        printf("%d: %2x\n", i, (unsigned char)output_data[i]);
    }
    
    // softmax
    arm_softmax_q7(output_data, 4, output_data);
    if (status != ARM_MATH_SUCCESS) {
        printf("softmax failed with status = %d\n", status);
    }

    printf("softmax:\n");
    for (int i = 0; i < 4; i++)
    {
        printf("%d: %d\n", i, (unsigned char)output_data[i]);
    }
}
```

## src/cmsis_nn_test.h
```c
// cmsis_nn_test.h

void cmsis_nn_test();
```

## src/i2s_mic.c
```c
#include <zephyr.h>
#include <nrfx_i2s.h>

#include "i2s_mic.h"


#include <logging/log.h>
LOG_MODULE_REGISTER(i2s_zephyr_mic, LOG_LEVEL_INF);

#define I2S_DATA_BLOCK_WORDS    512
static uint32_t m_buffer_rx[I2S_DATA_BLOCK_WORDS];


/* 
    data_handler

    Adapted from Nordic I2S loopback example.

*/
static void data_handler(nrfx_i2s_buffers_t const * p_released,
                         uint32_t                      status)
{
    // 'nrf_drv_i2s_next_buffers_set' is called directly from the handler
    // each time next buffers are requested, so data corruption is not
    // expected.
    //TODO assert(p_released);

    // When the handler is called after the transfer has been stopped
    // (no next buffers are needed, only the used buffers are to be
    // released), there is nothing to do.
    if (!(status & NRFX_I2S_STATUS_NEXT_BUFFERS_NEEDED))
    {
        return;
    }

    // First call of this handler occurs right after the transfer is started.
    // No data has been transferred yet at this point, so there is nothing to
    // check. Only the buffers for the next part of the transfer should be
    // provided.
    if (!p_released->p_rx_buffer)
    {
        nrfx_i2s_buffers_t const next_buffers = {
            .p_rx_buffer = m_buffer_rx,
            .p_tx_buffer = 0,
        };
        nrfx_i2s_next_buffers_set(&next_buffers);
    }
    else
    {
        uint32_t* data = p_released->p_rx_buffer;
        printk("data: %x, %x\n", data[0], data[1]);

        // The driver has just finished accessing the buffers pointed by
        // 'p_released'. They can be used for the next part of the transfer
        // that will be scheduled now.
        nrfx_i2s_next_buffers_set(p_released);
    }
}

ISR_DIRECT_DECLARE(i2s_isr_handler_mic) 
{
  nrfx_i2s_irq_handler();
  ISR_DIRECT_PM();

  return 1; 
}

void i2s_mic_init()
{
    nrfx_i2s_config_t config = NRFX_I2S_DEFAULT_CONFIG(26, 25, 255, 6, 7);
   
    // For SPH0645LM4H MEMS microphone, datasheet says: 
    // "the WS signal must be BCLK/64 and synchronized to the BCLK"
    // So set SCK to 32 MHz / 31 = 1.0322581 MHz and 
    // LRCLK to 1.0322581 MHz /64 = 16129.0328125 Hz
    config.sample_width = NRF_I2S_SWIDTH_24BIT_IN32BIT;
    config.channels  = NRF_I2S_CHANNELS_STEREO;
    config.mck_setup = NRF_I2S_MCK_32MDIV31;
    config.ratio     = NRF_I2S_RATIO_64X;

    IRQ_DIRECT_CONNECT(I2S0_IRQn, 0,i2s_isr_handler_mic, 0);

    int err_code = nrfx_i2s_init(&config, data_handler);

    LOG_INF("i2s_mic_init done...\n");
}

void i2s_mic_test()
{
    nrfx_i2s_buffers_t const initial_buffers = {
        .p_tx_buffer = 0,
        .p_rx_buffer = m_buffer_rx,
    };
    int err_code = nrfx_i2s_start(&initial_buffers, I2S_DATA_BLOCK_WORDS, 0);

}
```

## src/i2s_mic.h
```c
#ifndef I2S_MIC_H
#define I2S_MIC_H

void i2s_mic_init();

void i2s_mic_test();

#endif // NRFX_I2S_DEFAULT_CONFIG
```

## src/loopback.c
```c
#include <zephyr.h>
#include <nrfx_i2s.h>

#include <logging/log.h>
LOG_MODULE_REGISTER(i2s_zephyr_loopback, LOG_LEVEL_INF);


#define I2S_DATA_BLOCK_WORDS    512
static uint32_t m_buffer_rx[2][I2S_DATA_BLOCK_WORDS];
static uint32_t m_buffer_tx[2][I2S_DATA_BLOCK_WORDS];

// Delay time between consecutive I2S transfers performed in the main loop
// (in milliseconds).
#define PAUSE_TIME          500
// Number of blocks of data to be contained in each transfer.
#define BLOCKS_TO_TRANSFER  20

static uint8_t volatile m_blocks_transferred     = 0;
static uint8_t          m_zero_samples_to_ignore = 0;
static uint16_t         m_sample_value_to_send;
static uint16_t         m_sample_value_expected;
static bool             m_error_encountered;

static uint32_t       * volatile mp_block_to_fill  = NULL;
static uint32_t const * volatile mp_block_to_check = NULL;


static void prepare_tx_data(uint32_t * p_block)
{
    // These variables will be both zero only at the very beginning of each
    // transfer, so we use them as the indication that the re-initialization
    // should be performed.
    if (m_blocks_transferred == 0 && m_zero_samples_to_ignore == 0)
    {
        // Number of initial samples (actually pairs of L/R samples) with zero
        // values that should be ignored - see the comment in 'check_samples'.
        m_zero_samples_to_ignore = 2;
        m_sample_value_to_send   = 0xCAFE;
        m_sample_value_expected  = 0xCAFE;
        m_error_encountered      = false;
    }

    // [each data word contains two 16-bit samples]
    uint16_t i;
    for (i = 0; i < I2S_DATA_BLOCK_WORDS; ++i)
    {
        uint16_t sample_l = m_sample_value_to_send - 1;
        uint16_t sample_r = m_sample_value_to_send + 1;
        ++m_sample_value_to_send;

        uint32_t * p_word = &p_block[i];
        ((uint16_t *)p_word)[0] = sample_l;
        ((uint16_t *)p_word)[1] = sample_r;
    }
}


static bool check_samples(uint32_t const * p_block)
{
    // [each data word contains two 16-bit samples]
    uint16_t i;
    for (i = 0; i < I2S_DATA_BLOCK_WORDS; ++i)
    {
        uint32_t const * p_word = &p_block[i];
        uint16_t actual_sample_l = ((uint16_t const *)p_word)[0];
        uint16_t actual_sample_r = ((uint16_t const *)p_word)[1];

        // Normally a couple of initial samples sent by the I2S peripheral
        // will have zero values, because it starts to output the clock
        // before the actual data is fetched by EasyDMA. As we are dealing
        // with streaming the initial zero samples can be simply ignored.
        if (m_zero_samples_to_ignore > 0 &&
            actual_sample_l == 0 &&
            actual_sample_r == 0)
        {
            --m_zero_samples_to_ignore;
        }
        else
        {
            m_zero_samples_to_ignore = 0;

            uint16_t expected_sample_l = m_sample_value_expected - 1;
            uint16_t expected_sample_r = m_sample_value_expected + 1;
            ++m_sample_value_expected;

            if (actual_sample_l != expected_sample_l ||
                actual_sample_r != expected_sample_r)
            {
                LOG_INF("%3u: %04x/%04x, expected: %04x/%04x (i: %u)",
                    m_blocks_transferred, actual_sample_l, actual_sample_r,
                    expected_sample_l, expected_sample_r, i);
                return false;
            }
        }
    }
    LOG_INF("%3u: OK", m_blocks_transferred);
    return true;
}


static void check_rx_data(uint32_t const * p_block)
{
    ++m_blocks_transferred;

    if (!m_error_encountered)
    {
        m_error_encountered = !check_samples(p_block);
    }

    if (m_error_encountered)
    {
        //bsp_board_led_off(LED_OK);
        //bsp_board_led_invert(LED_ERROR);
    }
    else
    {
        //bsp_board_led_off(LED_ERROR);
        //bsp_board_led_invert(LED_OK);
    }
}


static void data_handler(nrfx_i2s_buffers_t const * p_released,
                         uint32_t                      status)
{
    // 'nrf_drv_i2s_next_buffers_set' is called directly from the handler
    // each time next buffers are requested, so data corruption is not
    // expected.
    //TODO assert(p_released);

    // When the handler is called after the transfer has been stopped
    // (no next buffers are needed, only the used buffers are to be
    // released), there is nothing to do.
    if (!(status & NRFX_I2S_STATUS_NEXT_BUFFERS_NEEDED))
    {
        return;
    }

    // First call of this handler occurs right after the transfer is started.
    // No data has been transferred yet at this point, so there is nothing to
    // check. Only the buffers for the next part of the transfer should be
    // provided.
    if (!p_released->p_rx_buffer)
    {
        nrfx_i2s_buffers_t const next_buffers = {
            .p_rx_buffer = m_buffer_rx[1],
            .p_tx_buffer = m_buffer_tx[1],
        };
        nrfx_i2s_next_buffers_set(&next_buffers);

        mp_block_to_fill = m_buffer_tx[1];
    }
    else
    {
        mp_block_to_check = p_released->p_rx_buffer;
        // The driver has just finished accessing the buffers pointed by
        // 'p_released'. They can be used for the next part of the transfer
        // that will be scheduled now.
        nrfx_i2s_next_buffers_set(p_released);

        // The pointer needs to be typecasted here, so that it is possible to
        // modify the content it is pointing to (it is marked in the structure
        // as pointing to constant data because the driver is not supposed to
        // modify the provided data).
        mp_block_to_fill = (uint32_t *)p_released->p_tx_buffer;
    }
}

ISR_DIRECT_DECLARE(i2s_isr_handler) 
{
  nrfx_i2s_irq_handler();
  ISR_DIRECT_PM();

  return 1; 
}

void loopback_init()
{
    nrfx_i2s_config_t config = NRFX_I2S_DEFAULT_CONFIG(31, 30, 255, 27, 26);
    // In Master mode the MCK frequency and the MCK/LRCK ratio should be
    // set properly in order to achieve desired audio sample rate (which
    // is equivalent to the LRCK frequency).
    // For the following settings we'll get the LRCK frequency equal to
    // 15873 Hz (the closest one to 16 kHz that is possible to achieve).
    config.sdin_pin  = 26;
    config.sdout_pin = 27;
    config.mck_setup = NRF_I2S_MCK_32MDIV21;
    config.ratio     = NRF_I2S_RATIO_96X;
    config.channels  = NRF_I2S_CHANNELS_STEREO;

    IRQ_DIRECT_CONNECT(I2S0_IRQn, 0,i2s_isr_handler, 0);

    int err_code = nrfx_i2s_init(&config, data_handler);

    LOG_INF("loopback_int done...\n");
}

void loopback_transfer()
{
    LOG_INF("staring loopback_transfer...\n");

    m_blocks_transferred = 0;
    mp_block_to_fill  = NULL;
    mp_block_to_check = NULL;

    prepare_tx_data(m_buffer_tx[0]);
    LOG_INF("after prepare_tx_data...\n");

    nrfx_i2s_buffers_t const initial_buffers = {
        .p_tx_buffer = m_buffer_tx[0],
        .p_rx_buffer = m_buffer_rx[0],
    };
    int err_code = nrfx_i2s_start(&initial_buffers, I2S_DATA_BLOCK_WORDS, 0);
    LOG_INF("err_code = %d...\n", err_code);

    //APP_ERROR_CHECK(err_code);

    LOG_INF("after nrfx_i2s_start...\n");

    do {
        // Wait for an event.
        //__WFE();
        // Clear the event register.
        //__SEV();
        //__WFE();

        if (mp_block_to_fill)
        {
            prepare_tx_data(mp_block_to_fill);
            mp_block_to_fill = NULL;
        }
        if (mp_block_to_check)
        {
            check_rx_data(mp_block_to_check);
            mp_block_to_check = NULL;
        }
    } while (m_blocks_transferred < BLOCKS_TO_TRANSFER);

    nrfx_i2s_stop();
}
```

## src/loopback.h
```c
#ifndef _LOOPBACK_H
#define _LOOPBACK_H

void loopback_init();

void loopback_transfer();

#endif // I2S_SDIN_PIN
```

## src/spectrogram.h
```c
// spectrogram.h
// File: no/01bb6a2a_nohash_0.wav 
// Original shape is (1, 32, 32, 1). Flattened using reshape(-1). 
#define IMG_DATA {0, 0, 0, 0, 0, 0, 0, 0, 0, 0, 0, 0, 0, 0, 0, 0, 0, 0, 0, 0, 0, 0, 0, 0, 0, 0, 0, 0, 0, 0, 0, 0, 0, 0, 0, 0, 0, 0, 0, 0, 0, 0, 0, 0, 0, 0, 0, 0, 0, 0, 0, 0, 0, 0, 0, 0, 0, 0, 0, 0, 0, 0, 0, 0, 0, 0, 0, 0, 0, 0, 0, 0, 0, 0, 0, 0, 0, 0, 0, 0, 0, 0, 0, 0, 0, 0, 0, 0, 0, 0, 0, 0, 0, 0, 0, 0, 0, 0, 0, 0, 0, 0, 0, 0, 0, 0, 0, 0, 0, 0, 0, 0, 0, 0, 0, 0, 0, 0, 0, 0, 0, 0, 0, 0, 0, 0, 0, 0, 0, 0, 0, 0, 0, 0, 0, 0, 0, 0, 0, 0, 0, 0, 0, 0, 0, 0, 0, 0, 0, 0, 0, 0, 0, 0, 0, 0, 0, 0, 0, 0, 0, 0, 0, 0, 0, 0, 0, 0, 0, 0, 0, 0, 0, 0, 0, 0, 0, 0, 0, 0, 0, 0, 0, 0, 0, 0, 0, 0, 0, 0, 0, 0, 0, 0, 0, 0, 0, 0, 0, 0, 0, 0, 0, 0, 0, 0, 0, 0, 0, 0, 0, 0, 0, 0, 0, 0, 0, 0, 0, 0, 0, 0, 0, 0, 0, 0, 0, 0, 0, 0, 0, 0, 0, 0, 0, 0, 0, 0, 0, 0, 0, 0, 0, 0, 0, 0, 0, 0, 0, 0, 0, 0, 0, 0, 0, 0, 0, 0, 0, 0, 0, 0, 0, 0, 0, 0, 0, 0, 0, 0, 0, 0, 0, 0, 0, 0, 0, 0, 0, 0, 0, 0, 0, 0, 0, 0, 0, 0, 0, 0, 0, 0, 0, 0, 0, 0, 0, 0, 0, 0, 0, 0, 0, 0, 0, 0, 0, 0, 0, 0, 0, 0, 0, 0, 0, 0, 0, 0, 0, 0, 0, 0, 0, 0, 0, 0, 0, 0, 0, 0, 0, 0, 0, 0, 0, 0, 0, 0, 0, 0, 0, 0, 0, 0, 0, 0, 0, 0, 0, 0, 0, 0, 0, 0, 0, 0, 0, 0, 0, 0, 0, 0, 0, 0, 0, 0, 0, 0, 0, 0, 0, 0, 0, 0, 0, 0, 0, 0, 0, 0, 0, 0, 0, 0, 0, 0, 0, 0, 0, 0, 0, 0, 0, 0, 0, 0, 0, 0, 0, 0, 0, 0, 0, 0, 0, 0, 0, 0, 0, 0, 0, 0, 0, 0, 0, 0, 0, 0, 0, 0, 0, 0, 0, 0, 0, 0, 0, 0, 0, 0, 0, 0, 0, 0, 0, 0, 0, 0, 0, 0, 0, 0, 0, 0, 0, 0, 0, 0, 0, 0, 0, 0, 0, 0, 0, 0, 0, 0, 0, 0, 0, 0, 0, 0, 0, 0, 0, 0, 0, 0, 0, 0, 0, 0, 0, 0, 0, 0, 0, 0, 2, 1, 0, 0, 0, 0, 0, 0, 0, 0, 0, 0, 0, 0, 0, 0, 0, 0, 0, 0, 0, 0, 0, 0, 0, 0, 0, 0, 0, 0, 0, 0, 21, 35, 5, 2, 1, 1, 0, 0, 1, 0, 0, 0, 0, 0, 0, 0, 0, 0, 0, 0, 0, 0, 0, 0, 0, 0, 0, 0, 0, 0, 0, 0, 48, 80, 15, 3, 2, 3, 1, 1, 1, 1, 1, 1, 1, 0, 0, 1, 0, 0, 0, 0, 0, 0, 0, 0, 0, 0, 0, 0, 0, 0, 0, 0, 65, 120, 22, 4, 2, 4, 1, 2, 2, 1, 1, 1, 1, 1, 1, 1, 1, 1, 0, 0, 0, 0, 0, 0, 0, 0, 0, 0, 0, 0, 0, 0, 66, 151, 55, 18, 12, 13, 2, 2, 3, 2, 3, 5, 6, 7, 15, 13, 5, 2, 2, 6, 7, 4, 4, 2, 1, 2, 1, 1, 0, 0, 0, 0, 67, 164, 90, 38, 30, 17, 4, 2, 2, 1, 3, 5, 4, 6, 11, 8, 3, 1, 1, 4, 3, 3, 2, 1, 1, 1, 1, 0, 0, 0, 0, 0, 68, 168, 117, 52, 43, 14, 4, 2, 2, 1, 2, 3, 2, 8, 9, 3, 1, 0, 1, 2, 2, 3, 2, 1, 1, 1, 1, 0, 0, 0, 0, 0, 77, 174, 148, 68, 42, 7, 3, 4, 1, 1, 2, 3, 3, 5, 10, 4, 1, 1, 1, 1, 2, 3, 3, 1, 1, 1, 1, 0, 0, 0, 0, 0, 72, 145, 126, 80, 35, 4, 2, 2, 2, 1, 2, 3, 3, 4, 4, 2, 1, 0, 1, 1, 1, 2, 2, 1, 1, 0, 0, 0, 0, 0, 0, 0, 85, 182, 98, 106, 20, 6, 4, 3, 3, 2, 2, 2, 2, 6, 9, 3, 1, 0, 0, 0, 1, 3, 2, 1, 1, 1, 1, 0, 0, 0, 0, 0, 97, 133, 78, 55, 12, 3, 3, 3, 2, 2, 1, 1, 1, 3, 4, 1, 1, 1, 1, 1, 1, 1, 1, 1, 0, 0, 0, 0, 0, 0, 0, 0, 118, 108, 25, 30, 3, 1, 2, 2, 1, 1, 1, 0, 0, 1, 1, 1, 1, 1, 0, 0, 0, 0, 0, 0, 0, 0, 0, 0, 0, 0, 0, 0, 30, 38, 9, 4, 1, 0, 0, 0, 0, 0, 0, 0, 0, 0, 0, 0, 0, 0, 0, 0, 0, 0, 0, 0, 0, 0, 0, 0, 0, 0, 0, 0, 3, 2, 0, 0, 0, 0, 0, 0, 0, 0, 0, 0, 0, 0, 0, 0, 0, 0, 0, 0, 0, 0, 0, 0, 0, 0, 0, 0, 0, 0, 0, 0, 0, 0, 0, 0, 0, 0, 0, 0, 0, 0, 0, 0, 0, 0, 0, 0, 0, 0, 0, 0, 0, 0, 0, 0, 0, 0, 0, 0, 0, 0, 0, 0, 0, 0, 0, 0, 0, 0, 0, 0, 0, 0, 0, 0, 0, 0, 0, 0, 0, 0, 0, 0, 0, 0, 0, 0, 0, 0, 0, 0, 0, 0, 0, 0, 0, 0, 0, 0, 0, 0, 0, 0, 0, 0, 0, 0, 0, 0, 0, 0, 0, 0, 0, 0, 0, 0, 0, 0, 0, 0, 0, 0, 0, 0, 0, 0, };
```

## src/weights.h
```c
/*Weights and shifts file*/
#define CONV1_WT {17,13,24,-26,24,15,72,6,-20,-7,-30,24,-98,6,23,13,-6,-25,31,18,8,-42,8,12,39,-38,4,-1,-30,58,-50,15,18,6,5,19,-16,35,-20,-37,3,-57,-50,-65,30,-34,-41,68,-7,23,-67,-27,-33,8,-19,18,-8,39,-41,14,-74,58,35,-41,38,13,18,8,45,19,-79,-33,9,9,11,29,37,-15,-12,-54,-26,-6,39,-16,55,6,-62,-30,12,-24,-21,-24,43,-88,-40,-15,35,4,-90,28,-49,-30,-19,20,-10,-5,49,-34,-9,-15,-49,20,-46,-2,-68,18,-99,-37,-47,31,-10,29,-2,35,53,-66,59,-93,18,12,16,3,-31,25,-72,-12,34,-11,33,2,-15,-112,-17,-4}
#define CONV1_BIAS {42,-1,6,-1,0,0,73,1,66,-14,6,-2,51,16,65,2}

#define IP1_WT {-3,-2,2,-2,-9,-8,-9,-10,5,-22,8,-9,1,5,18,7,16,-17,14,24,3,-17,-5,11,23,-8,10,-16,-3,1,-5,-11,6,3,13,24,5,10,-6,4,-16,0,-2,-12,13,12,7,-4,-2,7,9,11,10,15,6,-3,23,-5,-8,-20,-22,-26,0,30,-32,-31,16,36,-8,-4,21,37,-3,21,-14,33,-27,3,3,35,-19,-8,32,47,-9,-11,-15,32,28,-18,26,1,-47,-27,22,36,9,-12,0,35,-49,-9,9,38,-37,12,2,12,-46,-10,35,51,12,41,-10,6,23,-23,12,-20,-59,29,1,20,8,22,5,1,33,-13,-20,6,26,20,-34,1,6,-20,5,-8,41,23,-26,-26,-50,5,6,10,0,-4,-12,4,2,-35,-8,7,-9,34,-23,1,53,0,-17,-38,23,10,-49,-15,29,4,-16,-11,-7,-2,-37,27,49,16,-14,-52,5,-19,-27,15,-23,49,-74,-12,-30,-16,20,-3,54,18,25,-23,6,11,20,-11,-18,7,6,-10,12,37,20,-25,-19,29,-6,4,-13,16,9,-3,41,10,-20,12,32,19,-22,7,3,16,-7,-39,3,23,-18,-7,25,32,-14,-67,39,3,22,-32,11,11,6,-38,9,3,-56,35,4,7,-22,25,10,9,5,20,0,-18,37,-20,18,17,22,-2,-37,1,8,-10,6,0,18,-13,-22,31,17,-6,-46,12,36,-4,13,23,-26,-21,7,-34,49,-46,-28,-4,13,2,6,-4,6,-25,27,-2,24,-82,-24,-7,36,8,7,13,4,-24,6,14,32,-15,16,-13,55,-54,-33,26,21,9,-51,7,9,4,-29,8,21,-13,5,1,18,-10,-19,11,1,7,-52,26,24,-24,-34,-7,-5,16,37,-14,-5,3,-6,29,-8,5,9,-2,10,19,-22,23,9,-5,4,-13,9,-37,-29,0,-2,19,9,7,-23,8,8,-12,9,-14,-3,-1,13,-20,22,1,-7,20,2,23,-8,-19,-3,29,21,-1,14,-3,-11,29,-16,0,-24,15,-55,22,31,-21,-46,-3,5,-5,18,-3,5,-3,-1,27,-10,13,-5,20,3,-9,22,23,7,-24,18,-9,8,-22,-34,30,29,14,-11,-7,-22,2,10,-6,-38,27,8,10,-1,0,8,-17,6,13,8,15,8,15,-4,1,-6,-2,12,-2,-3,-1,-8,3,-8,3,25,-37,36,-1,2,3,3,6,14,-28,6,15,10,17,15,3,15,9,8,13,-3,4,-1,-1,-9,6,-4,-5,5,3,2,-6,-1,7,3,8,-10,-21,2,2,7,-9,-2,-14,3,-29,13,-12,-30,20,5,23,-13,-5,5,15,-17,-28,22,46,-1,20,10,-3,-45,-40,-17,61,-16,-28,-1,13,9,55,-3,-30,-46,-10,1,11,7,11,30,9,-40,-22,21,17,-14,-10,1,14,-42,-8,25,24,48,40,-11,-31,15,61,-15,-74,-73,1,8,5,14,7,-18,27,19,-14,-7,13,24,2,-5,27,9,35,2,25,24,-4,-8,-21,-20,7,-13,23,7,18,3,-17,49,-41,-8,-19,1,-6,-36,11,2,21,18,-26,-11,12,-22,20,15,7,-2,11,16,11,-24,19,14,13,42,-39,20,-21,23,-21,-16,21,-36,75,37,-20,13,-44,21,4,-14,-23,15,11,-13,-16,13,3,8,-42,0,-8,7,-7,-25,19,33,-53,-1,7,24,8,30,-3,13,-32,8,23,-19,0,19,15,26,-7,11,-4,-5,-3,0,7,-6,-40,18,-2,-1,-21,24,7,22,-28,18,13,2,-74,-22,28,19,-37,16,3,45,-46,14,-12,35,-36,-1,22,22,-7,9,20,-12,-15,18,-9,12,-17,-3,16,-6,7,10,38,-7,3,2,-9,19,-35,-8,-8,2,-17,5,35,-22,24,24,1,16,-8,3,14,0,-15,0,4,32,-47,-18,18,-3,-8,36,3,1,-77,0,6,9,-27,4,5,11,-33,3,16,42,-16,-27,7,29,-24,19,-2,2,-14,20,11,19,-2,-5,-11,22,-16,13,4,-11,11,52,20,-37,-11,5,13,9,6,-13,12,50,-16,-6,11,24,-15,38,39,4,-22,5,-28,21,-1,18,3,14,-16,39,27,-38,-15,17,3,-28,15,14,-5,-18,-13,-33,-5,6,-6,-4,-12,1,26,24,13,8,-20,-30,21,3,20,28,10,-4,-29,-33,-6,-1,-24,42,8,-4,-54,5,41,8,-13,-26,-3,-17,17,21,-1,-29,16,12,8,6,-17,11,22,-11,1,19,31,-22,16,11,42,-2,-44,42,25,-56,3,17,-5,-4,-39,6,11,7,11,0,6,-1,3,15,5,14,12,-6,13,1,2,12,-50,20,-11,-5,4,1,3,3,-19,1,16,5,8,7,3,5,7,2,4,7,9,5,-15,6,6,19,6,7,5,6,-7,-5,3,-6,4,4,1,9,19,19,-2,9,-2,7,-25,13,-30,-27,18,-7,28,-18,3,7,16,-9,-48,25,53,-5,4,-7,16,-44,-54,-11,40,14,-39,-3,-3,26,70,-20,-89,-45,-4,11,19,-14,-15,13,-11,-41,-18,31,35,-18,5,-3,22,-44,-23,16,12,32,31,-12,-50,48,62,5,-90,-74,17,11,11,4,-56,14,18,34,4,4,9,-2,-21,-28,6,-13,10,0,5,-4,14,3,-19,-19,18,-3,45,-7,7,24,-14,29,-18,-5,-18,-15,-3,-35,19,-12,7,-7,-34,6,12,-39,37,27,6,-27,-18,-9,2,-22,15,-7,-1,41,-45,-17,-19,45,-4,4,5,-13,47,9,20,18,20,25,1,10,-31,25,6,8,-33,8,-9,9,20,-8,3,0,-12,9,5,-7,-31,-3,-9,14,-32,26,7,-19,5,8,4,1,-16,12,20,17,-31,3,16,-30,-37,14,14,11,-54,9,1,-8,37,18,12,28,-38,8,8,1,3,-4,6,4,0,0,7,-3,24,27,-11,32,-32,2,-9,1,-17,-4,33,-3,-12,2,6,6,-19,-28,7,40,-11,-3,12,7,-7,-11,8,-4,30,7,-5,2,-10,34,10,-17,-17,-2,-2,-7,-16,36,-28,7,5,-2,-1,3,-31,19,11,11,-13,-33,33,-2,4,-52,14,29,11,10,26,-25,-20,51,-34,-4,1,15,-26,-8,-20,10,15,-21,37,0,-26,-19,-6,-64,50,-3,37,31,-25,-9,0,-56,41,2,35,44,-28,-26,22,48,-18,7,-1,39,-18,1,-16,30,-43,-44,21,50,-16,12,-30,12,-37,14,-16,-57,9,42,5,6,2,17,-12,-16,28,19,14,18,2,6,-6,27,6,18,-26,-9,19,-3,20,10,-23,-22,34,-25,32,25,-6,-7,23,-4,28,-32,20,10,16,19,-8,-11,4,31,14,3,8,10,-4,0,-13,6,-28,-12,20,3,-4,-24,-22,9,1,-22,16,-36,50,3,4,-20,15,10,-1,-21,32,-9,29,2,10,6,9,-3,8,2,1,15,2,10,5,0,13,2,7,40,-15,36,-2,-3,1,5,-3,-1,-13,-2,10,7,10,5,3,4,5,2,4,18,14,15,-2,15,7,14,11,9,10,10,-2,-11,-7,-14,-3,5,1,6,15,24,4,12,3,19,-6,22,-13,-34,12,-6,-1,-6,8,11,22,-3,-35,5,37,-10,4,-2,-1,-12,-72,-8,58,-7,-15,9,-4,30,65,6,-74,-40,8,10,24,5,-4,27,1,-51,-4,38,34,-2,-10,2,12,-43,-4,27,27,33,41,-13,-31,26,49,-4,-94,-54,4,20,10,-3,-24,1,24,25,22,-11,6,9,11,-29,18,-5,10,-15,-1,19,-7,-4,-10,11,-33,-42,47,14,8,20,-10,32,-63,-1,-18,12,6,-26,9,-15,13,1,-34,17,-10,-14,32,28,20,-14,10,14,14,-14,29,3,5,31,-48,15,-17,26,-27,-11,-14,-23,44,-7,-17,13,-18,9,5,8,-16,15,18,9,-4,7,-5,7,15,19,-4,25,-8,-43,-29,-3,52,17,25,26,-27,-24,15,-13,0,5,17,10,-12,-2,-13,-7,5,-14,0,-12,-2,-9,39,-19,-1,28,0,5,-2,28,11,20,-40,-5,3,10,-4,32,-5,-10,22,-17,-41,11,3,19,21,13,-20,1,-4,4,-25,14,5,9,0,3,-10,-7,2,-80,-6,48,37,21,20,-1,-4,-5,20,2,45,11,-6,12,-13,24,-6,-7,-27,-10,27,19,-7,-11,-1,-6,23,12,7,18,-1,16,-11,-29,14,6,32,14,30,-12,62,13,35,-3,0,-26,2,39,0,1,-31,21,-30,-6,-1,40,-19,30,-18,5,-43,-2,-20,-41,-22,8,34,20,-8,-6,-12,-15,-17,-18,63,36,7,19,-16,45,-23,-13,-22,6,-18,9,3,22,-2,5,-2,33,-2,9,-20,13,-8,-28,0,3,-18,-27,-8,-2,38,-40,16,-1,-11,40,-14,52,-30,-7,-23,26,-21,-13,-12,2,21,11,15,26,16,24,8,-38,-1,14,4,13,-1,-14,12,-4,5,39,-2,33,-21,17,-24,39,1,-31,-17,13,0,-3,7,-14,2,9,-6,66,-33,-10,-44,12,13,-28,20,18,-11,59,-7,7,37,15,-48,1,-11,32,18,-2,14,2,11,-9,2,-9,-8,9,0,3,-4,-12,3,-14,1,24,-19,29,-7,-6,4,7,0,6,-8,0,20,-1,8,0,-6,0,9,1,9,3,5,6,-12,6,-9,5,4,-2,2,1,-9,-8,3,-3,8,-9,-4,-9,10,8,-24,1,-9,7,-11,12,-29,-10,24,13,16,0,11,20,26,-5,-55,-16,25,3,12,-5,1,-19,-34,3,63,28,-9,21,14,27,66,6,-59,-42,0,0,8,-1,-21,16,5,-25,-17,35,16,3,-11,2,5,-26,-1,21,32,7,16,-32,-48,33,71,11,-86,-44,25,12,0,0,-50,1,38,22,2,-16,5,18,4,-6,3,-5,1,-20,-6,0,-2,4,1,-3,-20,6,29,18,-4,0,-27,7,-50,13,4,-1,1,-20,14,5,9,13,-5,21,7,-27,4,-11,3,-18,6,15,0,-28,19,4,19,16,-51,24,-22,38,-2,-15,-17,-23,48,-3,16,7,6,9,9,1,-28,5,20,0,-6,9,-28,-2,3,3,21,6,-14,-2,-45,15,-16,5,-6,8,-9,-37,-7,-3,13,2,14,6,2,14,21,13,4,-5,23,1,-7,9,17,33,1,6,3,-6,11,-9,9,12,-14,4,-12,25,-16,-8,6,-54,50,-17,-13,-1,17,28,6,-18,9,17,-20,-4,14,9,10,-8,11,0,-17,4,10,-31,-57,29,5,-15,0,-13,26,-32,-50,-5,56,-7,-13,-13,-5,21,-13,-29,-15,-25,-5,-8,2,-5,-10,15,8,1,17,-1,-18,24,-1,-16,-25,-17,14,-13,10,-3,39,-57,56,-33,6,-1,8,19,-23,3,-39,18,7,-10,2,-3,-15,-13,-13,15,-16,10,-42,-62,-12,23,20,4,2,-18,-5,-69,-30,23,59,0,-12,-27,-21,56,-12,-5,-27,-5,1,4,-10,-3,-59,-20,-8,30,-5,2,-17,17,-23,-22,1,-56,-59,18,74,-42,19,13,51,-11,-10,10,-14,29,-3,-33,-23,38,-13,-19,-30,0,-4,10,-11,29,-14,-6,-31,-66,-22,34,11,14,-9,-26,8,-31,-77,59,56,31,-25,1,-11,50,-5,-25,7,2,-8,-19,17,3,-33,-12,3,22,-3,1,-10,33,-9,-44,-4,-4,-28,47,22,34,-12,47,-31,-21,-24,65,5,-3,7,-6,7,7,15,7,12,-5,-4,-2,-2,5,13,-14,11,9,-13,34,-4,6,-3,0,-8,9,5,11,16,15,21,10,19,15,21,17,18,7,-8,10,-20,27,-1,25,7,0,12,2,-7,16,16,3,25,5,6,13,22,14,-4,6,-11,11,-8,21,-25,-9,14,6,-25,-27,1,6,7,12,-68,14,44,-12,-4,-7,-2,-15,-38,-10,33,17,2,21,13,17,68,4,-66,-14,14,4,-10,-10,-41,3,-3,-38,-19,25,49,32,-24,9,2,-13,-2,-16,11,33,32,-4,-33,6,54,14,-112,-22,39,-23,-14,33,-56,14,40,-1,-16,-4,30,-5,-14,-15,22,3,2,-12,8,-34,32,-3,20,23,-20,27,29,12,2,-15,17,59,-46,-15,0,2,-8,-11,9,-17,35,5,5,-17,-10,-3,28,-23,-16,-5,40,0,-14,-22,21,-29,22,42,-13,3,-18,10,-8,7,-35,-27,45,-6,12,5,21,11,31,26,-1,-11,14,-15,-22,-3,-8,10,34,11,-1,9,7,-31,-21,34,1,6,-12,-6,-14,-5,-17,-3,20,-26,33,-2,-13,46,-10,-26,1,8,-7,7,1,-30,-16,2,7,-19,13,5,-6,15,-16,-8,-2,2,16,4,-6,0,37,-36,24,-21,-10,-2,10,37,-43,3,-15,31,-19,21,-17,2,-32,0,6,7,-20,10,8,-46,-95,65,28,36,3,16,15,16,-32,-8,24,10,-18,14,2,29,-39,-7,4,10,-24,-5,21,-19,-49,18,20,10,-19,-5,22,43,-3,-29,15,-5,-58,-14,18,32,19,-74,20,-24,-28,44,4,66,-20,3,-18,43,-36,-12,-14,23,-56,-1,25,-9,-49,36,-19,-64,-36,68,0,30,-8,-27,4,-54,-6,36,28,36,0,-17,-16,37,-58,-26,-29,21,-16,-11,16,0,-60,46,35,39,-23,-8,-22,26,-37,2,-4,-37,26,-2,51,-31,-7,-15,62,-23,-28,14,20,66,-39,-13,-25,48,-36,17,2,13,-6,-14,32,39,-28,1,0,-39,-71,66,5,35,-7,-6,7,-73,-52,32,64,65,-48,-20,-35,56,-14,-12,-13,3,-9,6,21,-9,-85,50,-9,57,-44,-31,-30,30,-2,-47,35,-35,-45,13,44,27,-51,16,40,-22,-18,2,13,0,6,-6,4,-18,5,-10,-11,-17,34,-8,-21,-29,10,17,6,20,0,20,-4,0,23,-19,-10,10,-10,1,13,5,23,1,3,-20,16,-10,-8,-9,20,22,-4,-24,-23,31,1,-1,13,-10,-1,-20,9,-17,-4,-4,-10,-9,22,-7,-14,36,2,33,7,8,-25,-36,23,15,-22,-41,-7,7,-11,-13,-60,-7,42,-20,-16,-10,-7,-52,-2,-17,24,-28,-6,29,23,29,89,0,-88,5,14,-2,-26,-21,-31,22,20,-30,-26,9,16,-16,18,0,-25,-43,5,11,13,-6,10,8,-20,1,72,-21,-68,-12,42,-20,-24,16,-61,-2,31,-35,-45,-4,48,-9,-36,14,37,-29,-12,8,5,-45,-12,46,-1,-39,-14,4,11,-28,-16,11,-9,5,-27,-3,28,-5,-54,0,17,-17,1,14,20,-17,-29,-11,16,-80,-39,43,5,-22,-33,-13,37,-15,3,31,-8,28,-15,19,31,-1,-32,4,27,-14,-12,-1,24,-1,-29,6,2,8,-48,16,24,14,-44,8,1,5,-44,10,2,-47,-26,64,-23,19,-29,26,-22,-9,-1,33,12,2,-44,-1,30,23,-43,-5,-14,-28,-14,13,29,-33,-80,42,18,7,-41,-4,-2,18,-55,6,20,-32,19,-8,7,2,1,-23,14,7,-27,34,12,33,-67,21,-13,32,-37,17,-11,23,-29,31,16,9,-51,22,11,-47,-110,69,17,39,-25,33,8,-15,-3,42,32,23,-43,27,11,53,-73,-22,11,2,-22,2,5,-32,-95,44,26,21,-78,19,14,25,-28,-4,13,-22,-39,-7,18,-8,-8,-5,15,-6,-50,53,33,59,-78,18,23,52,-72,-17,32,26,-31,40,-6,46,-38,3,-9,-39,-95,62,28,21,-23,28,6,-37,-28,33,43,36,-54,-4,8,51,-70,5,4,5,-38,22,37,-1,-115,8,58,36,-66,10,-3,69,-39,-12,-7,-52,-9,35,47,-5,5,-11,32,11,-19,57,2,77,-75,-22,-26,45,-48,0,14,29,-12,3,23,47,-56,18,-25,-29,-94,36,51,43,-15,2,-16,3,-28,-7,28,85,-52,-13,-37,60,-52,-18,-8,9,-21,-2,33,16,-92,6,47,97,-83,-10,-34,33,-20,-15,28,46,-75,25,3,60,-29,-31,-5,-2,-60,7,-7}
#define IP1_BIAS {161,-22,23,-63}


#define CONV1_OUT_RSHIFT 8
#define CONV1_BIAS_LSHIFT 9

#define IP1_OUT_RSHIFT 8
#define IP1_BIAS_LSHIFT 9

#define INPUT_MEAN_SHIFT 174
#define INPUT_RIGHT_SHIFT 8
```
